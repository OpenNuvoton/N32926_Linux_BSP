## linux-2.6.35.4_fa92/arch/arm/mach-w55fa92/Kconfig
```kconfig
if ARCH_W55FA92

config CPU_W55FA92
	bool
	default y

menu "N9H2x/N329xx/W55FA92 Machines"

config ARCH_W55FA92DEV
	bool "N9H2x/N329xx/W55FA92 DEV-Nuvoton Evaluation Kit"
	select CPU_W55FA92
	help
	   Say Y here if you are using the Nuvoton Evaluation Kit N9H2x/N329xx/W55FA92 Demo Board
           <http://www.nuvoton.com>       

choice
	prompt "External Crystal"
	default EXTCLK_12M
	help
           N9H2x/N329xx/W55FA92 only supports 12M external crystal 

config EXTCLK_12M
	bool "12MHz"

config EXTCLK_27M
	bool "27MHz"

endchoice


config SET_CPU_CLOCK_BY_BOOT_CODE
       bool "CPU clock set by boot code"
       default n
       help
       Say Y here only if target system clock is configured by boot code

choice
        prompt "Kernel Load Address"
        default LD_ADDR_0
	help
           Default kernel load address for SD boot and NAND boot is 0x00000000. 
           Set to 0x00008000 only if you know what you are doing

config LD_ADDR_0
        bool "0x00000000"

config LD_ADDR_8000
        bool "0x00008000"
endchoice

config OPT_FPGA
        bool "Current board is FPGA board or not"
        default n

endmenu
endif
```

## linux-2.6.35.4_fa92/drivers/char/aac/Kconfig
```kconfig
config  W55FA92_AAC
	bool "Nuvoton N9H2x/N329xx/W55FA92 AAC Device Driver"
	depends on ARCH_W55FA92
	help
		Enable AAC or not.

config AAC_DRIVER_USE_INTERNAL_SRAM
	bool "AAC IMDCT/MDCT engine use internal 8K SRAM as in/out DMA buffer"
	depends on W55FA92_AAC
	default n
	---help---
	  Say Y here if you wnat to use internal 8K SRAM as in/out DMA buffer
```

## linux-2.6.35.4_fa92/drivers/char/blt/Kconfig
```kconfig
config  W55FA92_BLT
	tristate "Nuvoton N9H2x/N329xx/W55FA92 BLT Device Driver"
	depends on ARCH_W55FA92
	help
		Enable BLT or not.
```

## linux-2.6.35.4_fa92/drivers/char/rot/Kconfig
```kconfig
config W55FA92_ROT
	bool "N9H2x/N329xx/W55FA92 Rotation Engine support"
	depends on ARCH_W55FA92
	---help---
	  Say Y here if you wnat to use N9H2x/N329xx/W55FA92's Rotation Engine

config ROTATION_WIDTH
        int "Rotation max. width for buffer allocation"
        default 800
        depends on W55FA92_ROT
        help
          Default is 800

config ROTATION_HEIGHT
        int "Rotation max. height for buffer allocation"
        default 480
        depends on W55FA92_ROT
        help
          Default is 480

config ROTATION_PIXEL_WIDTH
        int "RGB565/YUV422 should 2. XRGB888 should be 4"
        default 2
        depends on W55FA92_ROT
        help
          Default is 2
```

## linux-2.6.35.4_fa92/drivers/char/vpe/Kconfig
```kconfig
config W55FA92_VPE
	bool "N9H2x/N329xx/W55FA92 Video Post-processing Engine support"
	depends on ARCH_W55FA92
	---help---
	  Say Y here if you wnat to use N9H2x/N329xx/W55FA92's Video Processing Engine
```

## linux-2.6.35.4_fa92/drivers/crypto/cryptodev/Kconfig
```kconfig
config  CRYPTODEV
	tristate "CryptoDev for Linux"
	help
		Enable CryptoDev for Linux
```

## linux-2.6.35.4_fa92/drivers/crypto/w55fa92-aes/Kconfig
```kconfig
config CRYPTO_DEV_W55FA92_AES
	tristate "N9H2x/N329xx/W55FA92 AES H/W accelerator"
	depends on ARCH_W55FA92
	select CRYPTO_ALGAPI
	select CRYPTO_BLKCIPHER
	help
		Enable Nuvoton N9H2x/N329xx/W55FA92 AES H/W accelerator
```

## linux-2.6.35.4_fa92/drivers/input/misc/w55fa92_adc/Kconfig
```kconfig
config INPUT_W55FA92_ADC
	bool "N9H2x/N329xx/W55FA92 Input ADC Function"
	depends on CPU_W55FA92
	help
	  If unsure, say N (but it's safe to say "Y").

config DOORBELL_DB_PINCODE
	bool "Switch pin code for doorbell demo board"
	default n
	depends on INPUT_W55FA92_ADC
	help
	  Default is 'N'.

config BATTERY_DETECTION
	bool "Support battery detection"
	default y
	depends on INPUT_W55FA92_ADC
	---help---
	  Say Y here if you need voltage detection. 

menu "Battery Channel Select"
	depends on BATTERY_DETECTION
config BATTERY_CHANNEL_1
        bool "Battery detection from channel 1"
config BATTERY_CHANNEL_2
        bool "Battery detection from channel 2"
config BATTERY_CHANNEL_3
        bool "Battery detection from channel 3"
config BATTERY_CHANNEL_4
        bool "Battery detection from channel 4"
config BATTERY_CHANNEL_5
        bool "Battery detection from channel 5"
config BATTERY_CHANNEL_6
        bool "Battery detection from channel 6"
config BATTERY_CHANNEL_7
        bool "Battery detection from channel 7"
endmenu

config KEYPAD_DETECTION
	bool "Support analog key pad"
	default y
	depends on !BATTERY_CHANNEL_2
	---help---
	  Say Y here if you need key pad input. keypad detection will always use channel 2.  


config TOUCH_DETECTION
	bool "Support touch pannel"
	default y
	depends on !(BATTERY_CHANNEL_4 || BATTERY_CHANNEL_5 || BATTERY_CHANNEL_6 || BATTERY_CHANNEL_7)
	---help---
	  Say Y here if you need touch pannel. 
```

## linux-2.6.35.4_fa92/drivers/media/jpeg/Kconfig
```kconfig
#
# HW jpeg codec configuration
#


menu "HW jpeg codec"
	depends on VIDEO_DEV

comment "Hardware jpeg codec"

source "drivers/media/jpeg/w55fa92/Kconfig"

endmenu # w55fa92 hw jpeg codec
```

## linux-2.6.35.4_fa92/drivers/media/video/w55fa92_dev1/Kconfig
```kconfig
config W55FA92_VIDEOIN_DEV1
	bool "N9H2x/N329xx/W55FA92 video capture port 1 support"
	depends on ARCH_W55FA92 && VIDEO_DEV
	---help---
	  Say Y here if you have N9H2x/N329xx/W55FA92chip(nuvoTon).

	  To compile this driver as a module, choose M here: the
	  module will be called W55FA92_videoin_dev1.

choice
	prompt "Board Select"
        default DEV_BOARD_DEV1
	depends on W55FA92_VIDEOIN_DEV1
		config  DEV_BOARD_DEV1
			bool "Developement board"
		config  DEMO_BOARD_DEV1
			bool "Demo board"
		config  VIDEODOOR_BOARD_DEV1
			bool "Videodoor board"
endchoice

config VIN_DEV1_ENCODE_WIDTH
        int "VideoIn DEV1 encode width"
        default 640
        depends on W55FA92_VIDEOIN_DEV1
        help
          Default is 640

config VIN_DEV1_ENCODE_HEIGHT
        int "VideoIn DEV1 encode height"
        default 480
        depends on W55FA92_VIDEOIN_DEV1
        help
          Default is 480

config VIN_DEV1_ENCODE_BUF_NO
        int "VideoIn DEV1 encode buffer numbers"
		range 2 3
        default 3
        depends on W55FA92_VIDEOIN_DEV1
        help
          Specified the encode buffer numbers

config VIN_DEV1_PREVIEW_WIDTH
        int "VideoIn DEV1 preview width"
        default 320
        depends on W55FA92_VIDEOIN_DEV1
        help
          Default is 320

config VIN_DEV1_PREVIEW_HEIGHT
        int "VideoIn DEV1 preview height"
        default 240
        depends on W55FA92_VIDEOIN_DEV1
        help
          Default is 240

config VIN_DEV1_PREVIEW_BUF_NO
        int "VideoIn DEV1 preview buffer numbers"
		range 3 3
        default 3
        depends on W55FA92_VIDEOIN_DEV1
        help
          Specified the preview buffer numbers

config SUPPORT_SENSOR_RESET_DEV1
	bool "Support sensor reset pin"
	default y
	depends on W55FA92_VIDEOIN_DEV1
	---help---
	  Say Y here if you need sensor reset pin. Please refer the circit. 

config SUPPORT_SENSOR_POWER_DOWN_DEV1
	bool "Support sensor power down pin"
	default y
	depends on W55FA92_VIDEOIN_DEV1
	---help---
	  Say Y here if you need sensor power down pin. Please refer the circit. 

config SUPPORT_SHARE_PACKET_BUFFER_DEV1
	tristate "Support share packet buffer with senor port 2"
	depends on W55FA92_VIDEOIN_DEV1
	---help---
	  Say Y here if you wnat to support share packet buffer with sensor port 2

config SUPPORT_SHARE_PLANAR_BUFFER_DEV1
	tristate "Support share planar buffer with senor port 2"
	depends on W55FA92_VIDEOIN_DEV1
	---help---
	  Say Y here if you wnat to support share planar buffer with sensor port 2

config SHARE_SENSOR
	tristate "Support share sensor to capture port 2"
	depends on W55FA92_VIDEOIN_DEV1
	---help---
	  Say Y here if you wnat to support share sensor to capture port 2.

config MOTION_DETECTION_DEV1
	tristate "Support motion detection function"
	depends on W55FA92_VIDEOIN_DEV1
	---help---
	  Say Y here if you wnat to support motion detection function.

choice 
	prompt "Encode format"
        default PLANAR_YUV422_YUV420_DEV1
	depends on W55FA92_VIDEOIN_DEV1
	
		config  PLANAR_YUV422_YUV420_DEV1
			bool "Support planar yuv422/yuv420"
		config  PLANAR_YUV420_DEV1
			bool "Support planar yuv420"
endchoice

choice
    prompt "Video Sensor support"
		default SENSOR_OV7725_DEV1
	depends on W55FA92_VIDEOIN_DEV1
 
		config SENSOR_OV9660_DEV1
			bool "OV9660 sensor support"
		config SENSOR_OV7670_DEV1
			bool "OV7670 sensor support"
		config SENSOR_OV7725_DEV1
			bool "OV7725 sensor support"
		config SENSOR_NT99140_DEV1
			bool "NT99140 sensor support"
		config SENSOR_NT99141_DEV1
			bool "NT99141 sensor support"
		config SENSOR_NT99142_DEV1
			bool "NT99142 sensor support"
		config SENSOR_NT99050_DEV1
			bool "NT99050 sensor support"
		config SENSOR_NT99160_DEV1
			bool "NT99160 sensor support"
		config SENSOR_NT99340_DEV1
			bool "NT99340 sensor support"
		config SENSOR_NT99252_DEV1
			bool "NT99252 sensor support"
		config SENSOR_NT99240_DEV1
			bool "NT99240 sensor support"
		config SENSOR_HM1375_DEV1
			bool "HM1375 sensor support"	
		config SENSOR_HM1055_DEV1
			bool "HM1055 sensor support"	
		config SENSOR_SP1628_DEV1
			bool "SP1628 sensor support"
		config SENSOR_TW9912_DEV1
			bool "TW9912 TV decoder support"	
		config SENSOR_GC0308_DEV1
			bool "GC0308 sensor support"
		config SENSOR_GC0303_DEV1
			bool "GC0303 sensor support"
		config SENSOR_AVNET_DEV1	
			bool "AVNET sensor support"	
		config SENSOR_OV10633_DEV1	
			bool "OV10633 sensor support"	
		config SENSOR_SC1046_DEV1	
			bool "SC1046 sensor support"
		config SENSOR_GM7150_DEV1	
			bool "GM7150 TV decoder support"	
		config SENSOR_TW9900_DEV1	
			bool "TW9900 TV decoder support"	
		config SENSOR_TVP5150_DEV1	
			bool "TVP5150 TV decoder support"
		config SENSOR_XC7021_DEV1
			bool "XC7021 ISP sensor support"			
endchoice

choice
    prompt "AEC/AWB target frame rate selection"
		default TARGET_25FPS
	depends on SENSOR_NT99141_DEV1 || SENSOR_NT99142_DEV1
		config TARGET_25FPS
			bool "AEC/AWB target fixed 25fps"
		config TARGET_23FPS
			bool "AEC/AWB target fixed 23fps"
		config TARGET_15FPS
			bool "AEC/AWB target 15fps at least"
		config TARGET_10FPS
			bool "AEC/AWB target 10fps at least"
endchoice

choice
    prompt "Raw data sensor selection"
		default SENSOR_SC2133_DEV1
	depends on SENSOR_XC7021_DEV1  
		config SENSOR_SC2033_DEV1
			bool "SC2033 raw data sensor"
		config SENSOR_SC2133_DEV1
			bool "SC2133 raw data sensor"
		config SENSOR_SC1143_DEV1
			bool "SC1143 raw data sensor"			
		config SENSOR_OV2710_DEV1
			bool "OV2710 raw data sensor"
		config SENSOR_OV9712_DEV1
			bool "OV9712 raw data sensor"			
endchoice

choice
    prompt "Frame rate selection"
		default 30_FRAME_DEV1
	depends on SENSOR_NT99050_DEV1  
		config 30_FRAME_DEV1
			bool "30 frames/sec"
		config 60_FRAME_DEV1
			bool "60 frames/sec"
endchoice

choice
    prompt "AEC/AWB target frame rate selection"
		default SC1046_TARGET_25FPS_DEV1
	depends on SENSOR_SC1046_DEV1
		config SC1046_TARGET_25FPS_DEV1
			bool "AEC/AWB target fixed 25fps"
		config SC1046_TARGET_20FPS_DEV1
			bool "AEC/AWB target fixed 20fps"	
endchoice

choice
    prompt "NTSC/PAL System selection"
		default NTSC_SYSTEM_DEV1
	depends on SENSOR_TW9912_DEV1 || SENSOR_GM7150_DEV1 || SENSOR_TW9900_DEV1 || SENSOR_TVP5150_DEV1
		config PAL_SYSTEM_DEV1
			bool "PAL system"
		config NTSC_SYSTEM_DEV1
			bool "NTSC system"
endchoice

choice
    prompt "One field or two fields selection"
		default ONE_FIELD_DEV1
	depends on SENSOR_GM7150_DEV1 || SENSOR_TW9900_DEV1 || SENSOR_TVP5150_DEV1
		config ONE_FIELD_DEV1
			bool "One field"
		config TWO_FIELDS_DEV1
			bool "Two fields"
endchoice


config PAL_CROP_START_X
        int "PAL Cropping Start Poistion X"
        default 47
        depends on PAL_SYSTEM_DEV1 && SENSOR_TW9912_DEV1
        help
          Default is 47 for PAL, 42 for NTSC system
config PAL_CROP_START_Y
         int "PAL Cropping Start Poistion Y"
        default 36
        depends on PAL_SYSTEM_DEV1 && SENSOR_TW9912_DEV1
        help
          Default is 36 for PAL, 37 for NTSC system
config NTSC_CROP_START_X
        int "NTSC Cropping Start Poistion X"
        default 42
        depends on NTSC_SYSTEM_DEV1 && SENSOR_TW9912_DEV1
        help
          Default is 47 for PAL, 42 for NTSC system
config NTSC_CROP_START_Y
         int "NTSC Cropping Start Poistion Y"
        default 37
        depends on NTSC_SYSTEM_DEV1 && SENSOR_TW9912_DEV1
        help
          Default is 36 for PAL, 37 for NTSC system

config PAL_CROP_START_X
        int "PAL Cropping Start Poistion X"
        default 76
        depends on PAL_SYSTEM_DEV1 && SENSOR_GM7150_DEV1
        help
          Default is 76 if one filed, 6 if two fields
config PAL_CROP_START_Y
         int "PAL Cropping Start Poistion Y"
        default 12
        depends on PAL_SYSTEM_DEV1 && SENSOR_GM7150_DEV1
        help
          Default is 12 if one filed, 35 if two fields
config NTSC_CROP_START_X
        int "NTSC Cropping Start Poistion X"
        default 76
        depends on NTSC_SYSTEM_DEV1 && SENSOR_GM7150_DEV1
        help
          Default is 76 if one filed, 6 if two fields
config NTSC_CROP_START_Y
         int "NTSC Cropping Start Poistion Y"
        default 12
        depends on NTSC_SYSTEM_DEV1 && SENSOR_GM7150_DEV1
        help
         Default is 12 if one filed, 35 if two fields

config PAL_CROP_START_X
        int "PAL Cropping Start Poistion X"
        default 88
        depends on PAL_SYSTEM_DEV1 && SENSOR_TW9900_DEV1
        help
          Default is 88 if one filed, 6 if two fields
config PAL_CROP_START_Y
         int "PAL Cropping Start Poistion Y"
        default 16
        depends on PAL_SYSTEM_DEV1 && SENSOR_TW9900_DEV1
        help
          Default is 16 if one filed, 35 if two fields
config NTSC_CROP_START_X
        int "NTSC Cropping Start Poistion X"
        default 88
        depends on NTSC_SYSTEM_DEV1 && SENSOR_TW9900_DEV1
        help
          Default is 88 if one filed, 6 if two fields
config NTSC_CROP_START_Y
         int "NTSC Cropping Start Poistion Y"
        default 16
        depends on NTSC_SYSTEM_DEV1 && SENSOR_TW9900_DEV1
        help
         Default is 16 if one filed, 35 if two fields

config PAL_CROP_START_X
        int "PAL Cropping Start Poistion X"
        default 76
        depends on PAL_SYSTEM_DEV1 && SENSOR_TVP5150_DEV1
        help
          Default is 76 if one filed, 6 if two fields
config PAL_CROP_START_Y
         int "PAL Cropping Start Poistion Y"
        default 12
        depends on PAL_SYSTEM_DEV1 && SENSOR_TVP5150_DEV1
        help
          Default is 12 if one filed, 35 if two fields
config NTSC_CROP_START_X
        int "NTSC Cropping Start Poistion X"
        default 76
        depends on NTSC_SYSTEM_DEV1 && SENSOR_TVP5150_DEV1
        help
          Default is 76 if one filed, 6 if two fields
config NTSC_CROP_START_Y
         int "NTSC Cropping Start Poistion Y"
        default 12
        depends on NTSC_SYSTEM_DEV1 && SENSOR_TVP5150_DEV1
        help
         Default is 12 if one filed, 35 if two fields

choice
    prompt "Video port connection"
		default VIDEO_PORT1
	depends on W55FA92_VIDEOIN_DEV1
  
		config VIDEO_PORT1
			bool "Data/Control==>GPB port"
		config VIDEO_PORT2
			bool "Data==>GPC port. Control==>GPA/GPE port"
		config VIDEO_PORT2_1
			bool "Data==>GPG/GPD port. Control==>GPD port"
endchoice


choice
    prompt "Flicker Setting"
		default FLICKER_60HZ_DEV1
	depends on W55FA92_VIDEOIN_DEV1
  
		config FLICKER_60HZ_DEV1
			bool "Flicker setting is 60Hz"
		config FLICKER_50HZ_DEV1
			bool "Flicker setting is 50Hz"		
endchoice
```
