## linux-2.6.35.4_fa92/drivers/net/arm/Kconfig
```kconfig
#
# Acorn Network device configuration
#  These are for Acorn's Expansion card network interfaces
#
config ARM_AM79C961A
	bool "ARM EBSA110 AM79C961A support"
	depends on ARM && ARCH_EBSA110
	select CRC32
	help
	  If you wish to compile a kernel for the EBSA-110, then you should
	  always answer Y to this.

config ARM_ETHER1
	tristate "Acorn Ether1 support"
	depends on ARM && ARCH_ACORN
	help
	  If you have an Acorn system with one of these (AKA25) network cards,
	  you should say Y to this option if you wish to use it with Linux.

config ARM_ETHER3
	tristate "Acorn/ANT Ether3 support"
	depends on ARM && ARCH_ACORN
	help
	  If you have an Acorn system with one of these network cards, you
	  should say Y to this option if you wish to use it with Linux.

config ARM_ETHERH
	tristate "I-cubed EtherH/ANT EtherM support"
	depends on ARM && ARCH_ACORN
	select CRC32
	help
	  If you have an Acorn system with one of these network cards, you
	  should say Y to this option if you wish to use it with Linux.

config ARM_AT91_ETHER
	tristate "AT91RM9200 Ethernet support"
	depends on ARM && ARCH_AT91RM9200
	select MII
	help
	  If you wish to compile a kernel for the AT91RM9200 and enable
	  ethernet support, then you should always answer Y to this.

config ARM_KS8695_ETHER
	tristate "KS8695 Ethernet support"
	depends on ARM && ARCH_KS8695
	select MII
	help
	  If you wish to compile a kernel for the KS8695 and want to
	  use the internal ethernet then you should answer Y to this.

config EP93XX_ETH
	tristate "EP93xx Ethernet support"
	depends on ARM && ARCH_EP93XX
	select MII
	help
	  This is a driver for the ethernet hardware included in EP93xx CPUs.
	  Say Y if you are building a kernel for EP93xx based devices.

config IXP4XX_ETH
	tristate "Intel IXP4xx Ethernet support"
	depends on ARM && ARCH_IXP4XX && IXP4XX_NPE && IXP4XX_QMGR
	select PHYLIB
	help
	  Say Y here if you want to use built-in Ethernet ports
	  on IXP4xx processor.

config W90P910_ETH
	tristate "Nuvoton w90p910 Ethernet support"
	depends on ARM && ARCH_W90X900
	select PHYLIB
	select MII
	help
	  Say Y here if you want to use built-in Ethernet ports
	  on w90p910 processor.

config W55FA92_ETH
	bool "Nuvoton N9H2x/N329xx/w55fa92 Ethernet support"
	depends on ARM && ARCH_W55FA92
	select PHYLIB
	select MII
	help
	  Say Y here if you want to use built-in Ethernet ports
	  on N9H2x/N329xx/W55FA92 processor.
choice
	prompt "Ethernet port select"
		default W55FA92_ETH_PORT0
		depends on W55FA92_ETH

config W55FA92_ETH_PORT0
	bool "N9H2x/N329xx/W55FA92 Ethernet 1st Port"

config W55FA92_ETH_PORT1
	bool "N9H2x/N329xx/W55FA92 Ethernet 2nd Port"
endchoice

choice
	prompt "Ethernet phy select"
		default W55FA92_ETH_PHY_RTL8201
		depends on W55FA92_ETH
		
config W55FA92_ETH_PHY_RTL8201
	bool "RTL8201 PHY"
	depends on W55FA92_ETH
	help
	  Say Y here if you want to use RTL8201 PHY
          on N9H2x/N329xx/W55FA92 processor.

config W55FA92_ETH_PHY_SR8201G
	bool "SR8201G PHY"
	depends on W55FA92_ETH
	help
	  Say Y here if you want to use SR8201G PHY
          on N9H2x/N329xx/W55FA92 processor.

config W55FA92_ETH_PHY_NO_ASSIGN
	bool "Not assign specific PHY"
	depends on W55FA92_ETH
	help
	  Say Y here if you want to assign general PHY
          on N9H2x/N329xx/W55FA92 processor.		  
		  
endchoice

config W55FA92_ETH_MII_PHY_ID
	int "PHY ID address for MII target"
	default -1
	depends on W55FA92_ETH
	help
	  Assign external phy id 0 ~ 3
          based on your PHY circuit,
          if assign -1, it will adopt driver's hard code ID.

config W55FA92_ETH_REFCLK_REVERSE
	bool "REVERSE EMAC REF_CLK"
	depends on W55FA92_ETH
	help
	  Say Y here if you want reverse EMC REF CLK
          on N9H2x/N329xx/W55FA92 processor.

config W55FA92_WAKE_ON_LAN
	bool "WOL Wake On Lan"
	depends on W55FA92_ETH
	help
	  Say Y here if you want support WOL
          on N9H2x/N329xx/W55FA92 processor.
```

## linux-2.6.35.4_fa92/sound/soc/w55fa92/Kconfig
```kconfig
##
## W55FA92 series SPU/I2S API
##

config SOUND_W55FA92_PLAY_DEVICE
	tristate "N9H2x/N329xx/W55FA92 Audio Playing and Recording Device"

choice
    prompt "Play device select"
        default SND_SOC_W55FA92_SPU
	depends on SOUND_W55FA92_PLAY_DEVICE

config SND_SOC_W55FA92_I2S
        tristate "I2S Audio Codec Support for Playing and Recording"
	select SND_SOC_NAU8822

config SND_SOC_W55FA92_SPU
        bool "N9H2x/N329xx/W55FA92 SPU Support for Playing"
endchoice

choice
    prompt "I2S Audio Codec Support select"
	default SND_SOC_W55FA92_I2S_NAU8822
	depends on SND_SOC_W55FA92_I2S

config SND_SOC_W55FA92_I2S_NAU8822
	bool "NAU8822"
	select SND_SOC_NAU8822

endchoice

choice
    prompt "I2S pinout select"
	default SND_SOC_W55FA92_I2S_PIN2GPB
	depends on SND_SOC_W55FA92_I2S

config SND_SOC_W55FA92_I2S_PIN2GPB
	bool "I2S to GPB pins"

config SND_SOC_W55FA92_I2S_PIN2GPG
	bool "I2S to GPG pins"
endchoice

choice
    prompt "SPU output select"
        default SPU_WITHOUT_I2S_OUTPUT
	depends on SND_SOC_W55FA92_SPU && !W55FA92_TV_FROM_APLL

config SPU_WITH_I2S_OUTPUT
        bool "N9H2x/N329xx/W55FA92 SPU with I2S signal output"

config SPU_WITHOUT_I2S_OUTPUT
		bool "N9H2x/N329xx/W55FA92 SPU without I2S signal output"
endchoice

config HEADSET_SPEAKER_CONTROL_PIN_SELECT
	tristate "Headset Detect and Speaker Control"

choice
    prompt "Headset detect Enable or Disabled ?"
        default HEADSET_DISABLED
	depends on HEADSET_SPEAKER_CONTROL_PIN_SELECT
      
config HEADSET_DISABLED
	bool "Headset detect Disabled"

config HEADSET_ENABLED
	bool "Headset detect Enabled"
endchoice	

choice
    prompt "Pins select"
        default HEADSET_GPB2_AND_SPEAKER_GPB3
	depends on HEADSET_ENABLED
      
config HEADSET_GPB2_AND_SPEAKER_GPB3
	bool "GPB2 for headset detect and GPB3 for speaker control"

config HEADSET_GPD14_AND_SPEAKER_GPA2
	bool "GPD14 for headset detect and GPA2 for speaker control"

config HEADSET_GPE0_AND_SPEAKER_GPE1
	bool "GPE0 for headset detect and GPE1 for speaker control"

config HEADSET_GPD3_AND_SPEAKER_GPD4
	bool "GPD3 for headset detect and GPD4 for speaker control"

endchoice

choice
    prompt "State select for GPD3"
        default HEADSET_GPD3_LOW
	depends on HEADSET_GPD3_AND_SPEAKER_GPD4
      
config HEADSET_GPD3_HIGH
	bool "HEADSET plug-in -> GPD3=High"

config HEADSET_GPD3_LOW
	bool "HEADSET plug-in -> GPD3=Low"

endchoice
```

## linux-2.6.35.4_fa92/sound/soc/w55fa92adc/Kconfig
```kconfig
##
## W55FA9X series ADC audio recording
##

#config SND_SOC_W55FA92
#	tristate "W55FA92 Audio Recording Device"
#	depends on ARCH_W55FA92
#	help
#	  This option enables support for ADC recording mode on the W55FA92 SoC.

config SND_SOC_W55FA92_ADC
	tristate "N9H2x/N329xx/W55FA92 ADC recording for demo board"
#	depends on SND_SOC_W55FA92
	select SND_SOC_W55FA92_CODEC_ADC     
	help
	  Select this option to enable audio recording from ADC on the
	  N9H2x/N329xx/W55FA92 demoboard.

choice
    prompt "Input Type Selection"
		default ANALOG_MIC
	depends on SND_SOC_W55FA92_ADC
  
		config ANALOG_MIC
			bool "Analog MIC Input"
		config MIC_IN_DISABLE_GAIN
			bool "Line in from MIC path and disable gain"
		config LINE_IN
			bool "Line Input"		
		config DIGITAL_MIC_MONO
			bool "Digital MIC Mono Input"
		config DIGITAL_MIC_STEREO
			bool "Digital MIC Stereo Input"
endchoice
```
